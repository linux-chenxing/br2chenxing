## Config.in
```kconfig
source "$BR2_EXTERNAL_CHENXING_PATH/package/snander/Config.in"

config BR2_CHENXING
	bool
	select BR2_PACKAGE_BUSYBOX_WATCHDOG
	select BR2_PACKAGE_HOST_UBOOT_TOOLS
	select BR2_PACKAGE_HOST_UBOOT_TOOLS_FIT_SUPPORT
	select BR2_PACKAGE_HOST_UBOOT_TOOLS_FIT_SIGNATURE_SUPPORT
# kernel selects
	select BR2_LINUX_KERNEL_DTS_SUPPORT
# misc selects
	select BR2_PACKAGE_HOST_GENIMAGE

# Default u-boot opts
config BR2_TARGET_UBOOT_CUSTOM_REPO_URL
	default "https://github.com/linux-chenxing/u-boot.git"

config BR2_TARGET_UBOOT_CUSTOM_REPO_VERSION
	default	"mstar_rebase_mainline_20220513"

config BR2_TARGET_UBOOT_SPL_NAME
	default "ipl"

# Default kernel opts
config BR2_LINUX_KERNEL_CUSTOM_REPO_URL
	default "https://github.com/linux-chenxing/linux.git"

config BR2_LINUX_KERNEL_CUSTOM_REPO_VERSION
	default "mstar_v5_19_rebase"

config BR2_LINUX_KERNEL_DTS_SUPPORT
	default y

config BR2_LINUX_KERNEL_DTB_OVERLAY_SUPPORT
	default y
```

## package/directfb2-ge/Config.in
```kconfig
config BR2_PACKAGE_DIRECTFB2_GE
        bool "directfb-ge"
	depends on BR2_PACKAGE_DIRECTFB2
	select BR2_PACKAGE_LIBGE
	help
	  DirectFB2 driver for GE
```

## package/isptool/Config.in
```kconfig
config BR2_PACKAGE_ISPTOOL
        bool "isptool"
	depends on BR2_PACKAGE_PYTHON_PERIPHERY
	help
	  Tool for interacting with mstar chips over the isp

config BR2_PACKAGE_HOST_ISPTOOL
        bool "host_isptool"
	help
	  Tool for interacting with mstar chips over the isp. Host
```

## package/mstarbintools/Config.in
```kconfig
config BR2_PACKAGE_MSTARBINTOOLS
        bool "mstarbintools"
	help
	  Tools for creating/manipulating mstar binaries

config BR2_PACKAGE_HOST_MSTARBINTOOLS
        bool "host_mstarbintools"
	help
	  Tools for creating/manipulating mstar binaries. Host
```

## package/snander/Config.in
```kconfig
config BR2_PACKAGE_SNANDER
        bool "snander"
	depends on BR2_HOST_GCC_AT_LEAST_4_9 # host-libusb
	help
	  SNANDer

config BR2_PACKAGE_SNANDER_MSTARDDC
        bool "mstar ddc supprt"
	depends on BR2_PACKAGE_SNANDER
	help
	  Add support for MStar DDC for flashing over i2c

config BR2_PACKAGE_HOST_SNANDER
        bool "host_snander"
	depends on BR2_HOST_GCC_AT_LEAST_4_9 # host-libusb
	help
	  SNANDer host package
```
